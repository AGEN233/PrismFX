## modules/argb_driver/Kconfig
```kconfig
config ENABLE_ARGB
    bool "Enable Addressable RGB"
    default y

menu "Addressable RGB Driver Configuration"
    depends on ENABLE_ARGB

    choice ARGB_TYPE
        prompt "ARGB TYPE"
        default ARGB_TYPE_WS2812B_SPI
        config ARGB_TYPE_WS2812B_SPI
            bool "WS2812B (SPI)"
        config ARGB_TYPE_WS2812B_RMT
            bool "WS2812B(RMT)"
        config ARGB_TYPE_SK6812
            bool "SK6812"
        
    endchoice

    config WS2812B_STACK_SIZE
        int "WS2812B SPI Task Stack Size (bytes)"
        default 1024
        range 256 8192
        depends on ARGB_TYPE_WS2812B_SPI || ARGB_TYPE_WS2812B_RMT

    config ARGB_OUT_PIN
        int "ARGB OUT_PIN"
        default 2
        range 0 39
        depends on (ARGB_TYPE_WS2812B_SPI || ARGB_TYPE_SK6812 || ARGB_TYPE_WS2812B_RMT)

    config LED_COUNT_MAX
        int "LED COUNT MAX"
        default 1024
endmenu
```

## modules/argb_driver/Kconfig.projbuild
```kconfig
menu "Addressable RGB Driver Configuration"

choice
    prompt "ARGB CHIP TYPE"
    default WS2812B

    config ARGB_TYPE_WS2812B
        bool "WS2812B"
    config ARGB_TYPE_SK6812
        bool "SK6812"
endchoice


endmenu # Addressable RGB Configuration
```

## modules/ble_iot/Kconfig
```kconfig
config ENABLE_BLE_IOT
    bool "Enable BLE IoT"
    default y
    help
        Enable the BLE IoT functionality. All BLE IoT settings depend on this.

if ENABLE_BLE_IOT && BT_NIMBLE_ENABLED
    menu "BLE IoT Configuration"
        config ENABLE_BLE_IOT_ADV
            bool "ENABLE BLE Advertising"
            default y
        config BLE_IOT_ADV_ITVL_MIN_MS
            depends on ENABLE_BLE_IOT_ADV
            int "Advertising Interval Min (ms)"
            default 80
            range 20 10240
            help
                "Minimum advertising interval in milliseconds (20ms ~ 10240ms)"
        config BLE_IOT_ADV_ITVL_MAX_MS
            depends on ENABLE_BLE_IOT_ADV
            int "dAdvertising Interval Max (ms)"
            default 80
            range 20 10240
            help
                "Maximum advertising interval in milliseconds (20ms ~ 10240ms)"
    endmenu

endif

if ENABLE_BLE_IOT && !BT_NIMBLE_ENABLED
    comment ">>>>>>WARNING>>>>>>"
    comment "BLE IoT requires NimBLE"
    comment "PLEASE enable BlueTooth and use NimBLE"
endif
```

## project_esp32c3/main/Kconfig.projbuild
```kconfig
menu "prismFX Project Configuration"

    config DEFAULT_LED_NUM
        int "Default LED NUMBER"
        default 200
        range 1 1024
        help
            Default number of LED pixels for prismFX device.

    source "../../modules/ble_iot/Kconfig"
    source "../../modules/argb_driver/Kconfig"

endmenu # prismFX Project Configuration
```
